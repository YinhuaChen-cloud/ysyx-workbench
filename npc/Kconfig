## npc/Kconfig
```kconfig
mainmenu "NPC Configuration Menu"

menu "Debug Options"
config SDB
  bool "Enable sdb (dependency of watchpoint)"
	default 0
config WATCHPOINTS
	depends on SDB
  bool "Enable watchpoints"
	default 1
config ITRACE
	bool "Enable instruction trace"
	default 0
config MTRACE
	bool "Enable mtrace"
	default 0
config DIFFTEST
  bool "Enable difftest"
	default 0
endmenu
```
